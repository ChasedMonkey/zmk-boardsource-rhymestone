## boards/shields/UwU/Kconfig.shield
```kconfig
# Copyright (c) 2025 Ellie Ernst
# SPDX-License-Identifier: MIT

config SHIELD_UWU_MASTER
	def_bool $(shields_list_contains,UwU_master)

config SHIELD_UWU_SLAVE
	def_bool $(shields_list_contains,UwU_slave)
```

## boards/shields/rhymestone/Kconfig.shield
```kconfig
# Copyright (c) 2025 Ellie Ernst
# SPDX-License-Identifier: MIT

config SHIELD_RHYMESTONE_LEFT
	def_bool $(shields_list_contains,Rhymestone_left)

config SHIELD_RHYMESTONE_RIGHT
	def_bool $(shields_list_contains,Rhymestone_right)
```
