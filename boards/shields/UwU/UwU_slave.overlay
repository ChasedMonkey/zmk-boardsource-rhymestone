/*
 * Copyright (c) 2025 Ellie Ernst
 *
 * SPDX-License-Identifier: MIT
 */

#include "UwU.dtsi"

&default_transform {
	col-offset = <5>;
};

&kscan0 {
	col-gpios
		= <&pro_micro_d 4 GPIO_ACTIVE_HIGH>
		, <&pro_micro_d 5 GPIO_ACTIVE_HIGH>
		, <&pro_micro_d 6 GPIO_ACTIVE_HIGH>
		, <&pro_micro_d 7 GPIO_ACTIVE_HIGH>
		, <&pro_micro_d 8 GPIO_ACTIVE_HIGH>
		;
};

&pro_micro_i2c {
    status = "okay";

    oled: ssd1306@3c {
        compatible = "solomon,ssd1306fb";
        reg = <0x3c>;
        width = <128>;
        height = <32>;
        segment-offset = <0>;
        page-offset = <0>;
        display-offset = <0>;
        multiplex-ratio = <31>;
        com-sequential;
        prechargep = <0x22>;
    };
};